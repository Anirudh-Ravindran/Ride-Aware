#define OTHER_NODE 2
// Ride-Aware two-node firmware. Requires Arduino-ESP32 3.x.
#include <Arduino.h>
#include <WiFi.h>
#include <esp_now.h>
#include <esp_wifi.h>
#include <esp_system.h>
#include <Wire.h>
#include <WebServer.h>
#include <DNSServer.h>
#include <freertos/FreeRTOS.h>
#include <freertos/task.h>
#include <math.h>
#include <string.h>

constexpr uint32_t MAGIC = 0x52494446;
constexpr uint8_t CHANNEL = 1;
constexpr char PHONE_SSID[] = "RideAware";
constexpr char PHONE_PASSWORD[] = "rideaware123";
WebServer server(80);
DNSServer dnsServer;
constexpr uint32_t LINK_TIMEOUT_MS = 3000;
constexpr uint8_t BROADCAST[] = {255,255,255,255,255,255};
// Keep this packet identical in BOTH sketches. Distances travel in cm;
// user-facing output converts to feet. distanceOK describes freshness.
struct __attribute__((packed)) Packet {
  uint32_t magic, sequence;
  uint8_t source, turn, brake, distanceOK, imuOK, blink;
  float distanceCm, forwardAccel;
};
static_assert(sizeof(Packet) == 22, "Packet layout changed");
bool takePacket(Packet &p, uint32_t &time);
void sendPacket(Packet &p);
portMUX_TYPE mailboxLock = portMUX_INITIALIZER_UNLOCKED;
Packet mailbox = {};
bool pendingPacket = false;
uint32_t receivedAt = 0;
bool radioReady = false;
uint32_t sequence = 0;

void onReceive(const esp_now_recv_info_t*, const uint8_t* data, int len) {
  if (len != sizeof(Packet)) return;
  Packet p;
  memcpy(&p, data, sizeof(p));
  if (p.magic != MAGIC || p.source != OTHER_NODE || p.turn > 2 ||
      p.brake > 1 || p.distanceOK > 1 || p.imuOK > 1 || p.blink > 1 ||
      !isfinite(p.distanceCm) || p.distanceCm < 0 || p.distanceCm > 400 ||
      !isfinite(p.forwardAccel)) return;
  portENTER_CRITICAL(&mailboxLock);
  mailbox = p;
  receivedAt = millis();
  pendingPacket = true;
  portEXIT_CRITICAL(&mailboxLock);
}
bool takePacket(Packet &p, uint32_t &time) {
  portENTER_CRITICAL(&mailboxLock);
  bool ready = pendingPacket;
  if (ready) { p = mailbox; time = receivedAt; pendingPacket = false; }
  portEXIT_CRITICAL(&mailboxLock);
  return ready;
}
bool startRadio() {
  // Keep the phone AP and ESP-NOW station interface on channel 1.
  // Do not call WiFi.begin() to join a separate router.
  WiFi.mode(WIFI_AP_STA);
  WiFi.setSleep(false);
  if (!WiFi.softAPConfig(IPAddress(192,168,4,1),IPAddress(192,168,4,1),IPAddress(255,255,255,0))) return false;
  if (!WiFi.softAP(PHONE_SSID, PHONE_PASSWORD, CHANNEL, 0, 2)) return false;
  if (esp_wifi_set_channel(CHANNEL, WIFI_SECOND_CHAN_NONE) != ESP_OK) return false;
  if (esp_now_init() != ESP_OK) return false;
  if (esp_now_register_recv_cb(onReceive) != ESP_OK) return false;
  esp_now_peer_info_t peer = {};
  memcpy(peer.peer_addr, BROADCAST, 6);
  peer.channel = CHANNEL;
  peer.ifidx = WIFI_IF_STA;
  peer.encrypt = false;
  return esp_now_add_peer(&peer) == ESP_OK;
}
void sendPacket(Packet &p) {
  if (!radioReady) return;
  p.magic = MAGIC;
  p.sequence = sequence++;
  if (esp_now_send(BROADCAST, reinterpret_cast<const uint8_t*>(&p), sizeof(p)) != ESP_OK)
    Serial.println("Radio: could not queue packet");
}

#include <Adafruit_GFX.h>
#include <Adafruit_SSD1306.h>
constexpr int LEFT_BUTTON=25, RIGHT_BUTTON=26;
constexpr int LEFT_LED=18, RIGHT_LED=19;
constexpr int OLED_SDA=21, OLED_SCL=22;
Adafruit_SSD1306 display(128,64,&Wire,-1);
bool displayReady=false, rearSeen=false, hasDistance=false;
uint8_t requestedTurn=0;
portMUX_TYPE commandLock = portMUX_INITIALIZER_UNLOCKED;
uint8_t heartbeatTurn=0;
bool heartbeatReady=false;
uint32_t lastRearAt=0, lastSend=0, lastDisplay=0, lastLog=0;
float lastDistanceCm=0;
Packet rear={};

// Only this task sends commands when task creation succeeds.
// Phone requests and OLED transfers run in loop(), independently.
void commandHeartbeat(void*) {
  for (;;) {
    Packet p={};
    p.source=1;
    portENTER_CRITICAL(&commandLock);
    p.turn=heartbeatTurn;
    portEXIT_CRITICAL(&commandLock);
    sendPacket(p);
    vTaskDelay(pdMS_TO_TICKS(110));
  }
}
struct Button {
  int pin;
  bool raw=HIGH, stable=HIGH;
  uint32_t changedAt=0;
};
Button leftButton={LEFT_BUTTON}, rightButton={RIGHT_BUTTON};
// Explicit declaration avoids Arduino-generated prototypes before custom types.
bool pressed(Button &button, uint32_t now);
bool pressed(Button &button, uint32_t now) {
  bool value=digitalRead(button.pin);
  if (value!=button.raw) { button.raw=value; button.changedAt=now; }
  if (value!=button.stable && now-button.changedAt>=35) {
    button.stable=value;
    return value==LOW;
  }
  return false;
}
void drawScreen(bool linked) {
  if (!displayReady) return;
  display.clearDisplay();
  display.setTextColor(SSD1306_WHITE);
  display.setTextSize(1);
  display.setCursor(0,0);
  display.print("Ride-Aware");
  if (linked) display.fillCircle(94,4,3,SSD1306_WHITE);
  else display.drawCircle(94,4,3,SSD1306_WHITE);
  display.setCursor(102,0);
  display.print(linked?"LINK":"OFF");
  display.drawLine(0,12,127,12,SSD1306_WHITE);

  // Direction arrow flashes with the rear's acknowledged turn.
  if (linked && rear.blink) {
    if (rear.turn==1) {
      display.fillRect(25,26,31,10,SSD1306_WHITE);
      display.fillTriangle(26,18,26,44,7,31,SSD1306_WHITE);
    } else if (rear.turn==2) {
      display.fillRect(72,26,31,10,SSD1306_WHITE);
      display.fillTriangle(101,18,101,44,120,31,SSD1306_WHITE);
    }
  }
  char feet[20];
  if (hasDistance) snprintf(feet,sizeof(feet),"%.1f ft",lastDistanceCm/30.48f);
  else snprintf(feet,sizeof(feet),"-- ft");
  int x=(128-static_cast<int>(strlen(feet))*12)/2;
  display.setTextSize(2);
  display.setCursor(x<0?0:x,48);
  display.print(feet);
  display.display();
}

// Encoded webpage: ordinary C strings prevent Arduino from scanning JavaScript as sketch functions.
// Human-readable source: phone-preview.html. No additional upload is required.
const char PHONE_PAGE[] PROGMEM =
"\x3c\x21\x64\x6f\x63\x74\x79\x70\x65\x20\x68\x74\x6d\x6c\x3e\x0a\x3c\x68\x74\x6d\x6c\x20\x6c\x61\x6e\x67\x3d\x22\x65\x6e\x22\x3e\x3c\x68\x65\x61\x64\x3e\x3c\x6d\x65\x74\x61\x20\x63\x68\x61\x72\x73\x65\x74\x3d\x22\x75\x74\x66\x2d\x38\x22\x3e\x3c\x6d\x65\x74"
"\x61\x20\x6e\x61\x6d\x65\x3d\x22\x76\x69\x65\x77\x70\x6f\x72\x74\x22\x20\x63\x6f\x6e\x74\x65\x6e\x74\x3d\x22\x77\x69\x64\x74\x68\x3d\x64\x65\x76\x69\x63\x65\x2d\x77\x69\x64\x74\x68\x2c\x69\x6e\x69\x74\x69\x61\x6c\x2d\x73\x63\x61\x6c\x65\x3d\x31\x22\x3e\x0a"
"\x3c\x74\x69\x74\x6c\x65\x3e\x52\x69\x64\x65\x2d\x41\x77\x61\x72\x65\x3c\x2f\x74\x69\x74\x6c\x65\x3e\x3c\x73\x74\x79\x6c\x65\x3e\x0a\x3a\x72\x6f\x6f\x74\x7b\x66\x6f\x6e\x74\x2d\x66\x61\x6d\x69\x6c\x79\x3a\x73\x79\x73\x74\x65\x6d\x2d\x75\x69\x2c\x73\x61\x6e"
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"\x73\x75\x73\x70\x65\x6e\x64\x28\x29\x2e\x63\x61\x74\x63\x68\x28\x28\x29\x3d\x3e\x7b\x7d\x29\x3b\x7d\x0a\x20\x20\x72\x65\x6e\x64\x65\x72\x28\x29\x3b\x0a\x7d\x29\x3b\x0a\x73\x65\x74\x49\x6e\x74\x65\x72\x76\x61\x6c\x28\x28\x29\x3d\x3e\x7b\x61\x75\x64\x69\x6f"
"\x54\x69\x63\x6b\x28\x29\x3b\x72\x65\x6e\x64\x65\x72\x28\x29\x3b\x7d\x2c\x33\x30\x29\x3b\x0a\x70\x6f\x6c\x6c\x28\x29\x3b\x0a\x3c\x2f\x73\x63\x72\x69\x70\x74\x3e\x3c\x2f\x62\x6f\x64\x79\x3e\x3c\x2f\x68\x74\x6d\x6c\x3e\x0a";

void servePhoneStatus() {
  uint32_t now=millis();
  uint32_t age=rearSeen?now-lastRearAt:0;
  bool linked=radioReady && rearSeen && age<LINK_TIMEOUT_MS;
  // Audio freshness is stricter than the OLED's disconnection grace period.
  bool fresh=linked && age<=500 && rear.distanceOK && rear.distanceCm>=2.0f;
  char distance[24]="null", rxAge[24]="null", json[512];
  if (hasDistance) snprintf(distance,sizeof(distance),"%.3f",lastDistanceCm/30.48f);
  if (rearSeen) snprintf(rxAge,sizeof(rxAge),"%lu",(unsigned long)age);
  snprintf(json,sizeof(json),
    "{\"radioOK\":%s,\"linked\":%s,\"requestedTurn\":%u,\"turn\":%u,"
    "\"blink\":%s,\"brake\":%s,\"imuOK\":%s,\"distanceFt\":%s,"
    "\"distanceFresh\":%s,\"rxAgeMs\":%s,\"uptimeMs\":%lu}",
    radioReady?"true":"false",linked?"true":"false",requestedTurn,linked?rear.turn:0,
    linked&&rear.blink?"true":"false",linked&&rear.brake?"true":"false",
    linked&&rear.imuOK?"true":"false",distance,fresh?"true":"false",rxAge,(unsigned long)now);
  server.sendHeader("Cache-Control","no-store");
  server.sendHeader("Connection","close");
  server.send(200,"application/json",json);
}
void redirectToPortal() {
  server.sendHeader("Cache-Control","no-store");
  server.sendHeader("Location","http://192.168.4.1/",true);
  server.sendHeader("Connection","close");
  server.send(302,"text/plain","Open Ride-Aware at http://192.168.4.1/");
}
void startPhoneServer() {
  server.on("/",HTTP_GET,[](){
    server.sendHeader("Cache-Control","no-store");
    server.send_P(200,"text/html; charset=utf-8",PHONE_PAGE);
  });
  server.on("/api/status",HTTP_GET,servePhoneStatus);
  // Answer connectivity probes with the portal instead of an internet-success page.
  const char* probes[]={"/hotspot-detect.html","/library/test/success.html",
    "/generate_204","/gen_204","/connecttest.txt","/ncsi.txt","/redirect"};
  for (const char* path:probes) server.on(path,HTTP_GET,redirectToPortal);
  server.onNotFound(redirectToPortal);
  bool dnsReady=dnsServer.start(53,"*",IPAddress(192,168,4,1));
  Serial.println(dnsReady?"Captive portal DNS ready":"Captive DNS failed: use numeric IP in Safari");
  server.begin();
  Serial.println("PHONE: join RideAware / password rideaware123");
  Serial.println("PHONE: open http://192.168.4.1 and tap Enable sound");
}

void setup() {
  Serial.begin(115200); delay(1500);
  Serial.printf("FRONT v13: INDEPENDENT HEARTBEAT / 3 FT / MAX BEEP AT 0.5 FT. Reset reason: %d\n",static_cast<int>(esp_reset_reason()));
  pinMode(LEFT_BUTTON,INPUT_PULLUP); pinMode(RIGHT_BUTTON,INPUT_PULLUP);
  pinMode(LEFT_LED,OUTPUT); pinMode(RIGHT_LED,OUTPUT);
  digitalWrite(LEFT_LED,LOW); digitalWrite(RIGHT_LED,LOW);
  Wire.begin(OLED_SDA,OLED_SCL); Wire.setClock(100000); Wire.setTimeOut(20);
  uint8_t address=0;
  for (uint8_t candidate=0x3C;candidate<=0x3D;candidate++) {
    Wire.beginTransmission(candidate);
    if (Wire.endTransmission()==0) { address=candidate; break; }
  }
  if (address) displayReady=display.begin(SSD1306_SWITCHCAPVCC,address,false,false);
  Serial.println(displayReady?"OLED ready":"OLED missing: buttons/radio still run");
  radioReady=startRadio();
  Serial.println(radioReady?"FRONT: ESP-NOW ready, channel 1":"RADIO FAILED: press RESET");
  if (radioReady) {
    heartbeatReady=xTaskCreate(commandHeartbeat,"RideHeartbeat",4096,nullptr,1,nullptr)==pdPASS;
    Serial.println(heartbeatReady?"Independent radio heartbeat ready":"Heartbeat task failed: using loop fallback");
  }
  startPhoneServer();
  drawScreen(false);
}
void loop() {
  uint32_t now=millis(), packetTime=0;
  Packet incoming;
  if (takePacket(incoming,packetTime)) {
    rear=incoming; lastRearAt=packetTime; rearSeen=true;
    // Carry a valid held value across missing echoes or a rear restart.
    if (rear.distanceCm>=2.0f) { lastDistanceCm=rear.distanceCm; hasDistance=true; }
  }
  now=millis(); // Sample AFTER taking the packet; prevent unsigned timestamp underflow.
  uint32_t rxAge=rearSeen?now-lastRearAt:0;
  bool linked=radioReady && rearSeen && rxAge<LINK_TIMEOUT_MS;
  static uint32_t previousLoopAt=0;
  if (previousLoopAt && now-previousLoopAt>=500) {
    Serial.printf("LOOP GAP: %lu ms | Heartbeat:%s\n",(unsigned long)(now-previousLoopAt),heartbeatReady?"TASK":"LOOP FALLBACK");
  }
  previousLoopAt=now;
  static bool previousLink=false;
  if (linked!=previousLink) {
    Serial.printf("LINK %s | RX age:%lu ms | Uptime:%lu s\n",linked?"ON":"OFF",(unsigned long)rxAge,(unsigned long)(now/1000));
    previousLink=linked;
  }
  if (pressed(leftButton,now)) requestedTurn=requestedTurn==1?0:1;
  if (pressed(rightButton,now)) requestedTurn=requestedTurn==2?0:2;
  portENTER_CRITICAL(&commandLock);
  heartbeatTurn=requestedTurn;
  portEXIT_CRITICAL(&commandLock);
  // Front LEDs show the turn actually acknowledged by the rear.
  uint8_t actualTurn=linked?rear.turn:0;
  bool flash=linked && rear.blink; // Follow the rear phase, not an independent clock.
  digitalWrite(LEFT_LED,actualTurn==1 && flash);
  digitalWrite(RIGHT_LED,actualTurn==2 && flash);
  if (!heartbeatReady && now-lastSend>=110) {
    lastSend=now;
    Packet p={}; p.source=1; p.turn=requestedTurn; sendPacket(p);
  }
  // Redraw immediately when the same phase used by the front LEDs changes.
  // The 200 ms refresh is only a fallback for distance updates.
  static bool drawnLinked=false, drawnFlash=false;
  static uint8_t drawnTurn=0;
  if (linked!=drawnLinked || flash!=drawnFlash || actualTurn!=drawnTurn || now-lastDisplay>=200) {
    lastDisplay=now;
    drawScreen(linked);
    drawnLinked=linked; drawnFlash=flash; drawnTurn=actualTurn;
  }
  if (now-lastLog>=500) {
    lastLog=now;
    Serial.printf("Uptime:%lu s RX age:%lu ms Rear:%s Requested turn:%u Actual turn:%u Brake:%s | ",
      (unsigned long)(millis()/1000),(unsigned long)(rearSeen?millis()-lastRearAt:0),
      linked?"LINKED":"OFFLINE",requestedTurn,actualTurn,!linked?"UNKNOWN":rear.brake?"ON":"OFF");
    if (hasDistance) Serial.printf("%.2f ft [%s]\n",lastDistanceCm/30.48f,
      linked && rear.distanceOK?"LIVE":"LAST KNOWN");
    else Serial.println("Distance: waiting for first echo");
  }
  dnsServer.processNextRequest();
  server.handleClient();
  delay(1);
}
